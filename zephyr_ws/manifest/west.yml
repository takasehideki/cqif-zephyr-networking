## zephyr_ws/manifest/west.yml
```yaml
# SPDX-License-Identifier: Apache-2.0
manifest:
  projects:
    - name: zephyr
      url: https://github.com/zephyrproject-rtos/zephyr
      revision: v4.4.2
      path: zephyr
      west-commands: scripts/west-commands.yml
      import: true

    - name: zenoh-pico
      url: https://github.com/eclipse-zenoh/zenoh-pico
      revision: 1.10.2
      path: modules/lib/zenoh-pico
  self:
    path: manifest
```
