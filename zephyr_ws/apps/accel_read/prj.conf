## CMakeLists.txt
```
# SPDX-License-Identifier: Apache-2.0
cmake_minimum_required(VERSION 3.20.0)

find_package(Zephyr REQUIRED HINTS
  "${CMAKE_CURRENT_SOURCE_DIR}/../../zephyr/share/zephyr-package/cmake"
)
project(accel_read)

set(COMMON_DIR ${CMAKE_CURRENT_SOURCE_DIR}/../common)
target_include_directories(app PRIVATE ${COMMON_DIR})
target_sources(app PRIVATE src/main.c ${COMMON_DIR}/accel.c)
```

## prj.conf
```kconfig
# SPDX-License-Identifier: Apache-2.0
# 加速度センサに関する設定
CONFIG_SENSOR=y
CONFIG_MPU6050=y
CONFIG_I2C=y

# メインスレッドのスタックサイズ
CONFIG_MAIN_STACK_SIZE=2048

# 64ビット整数を含む整数の書式変換を有効にする
CONFIG_CBPRINTF_FULL_INTEGRAL=y

# ロギングに関する設定
CONFIG_LOG=y
CONFIG_LOG_PRINTK=y
CONFIG_LOG_MODE_DEFERRED=y
CONFIG_LOG_PROCESS_TRIGGER_THRESHOLD=1
CONFIG_LOG_BUFFER_SIZE=4096
```

## src/main.c
```c
/* SPDX-License-Identifier: Apache-2.0 */
#include <zephyr/kernel.h>
#include <zephyr/logging/log.h>

#include "accel.h"

#define ACCEL_PERIOD_MS 100

LOG_MODULE_REGISTER(accel_read, LOG_LEVEL_INF);
K_TIMER_DEFINE(sample_timer, NULL, NULL);

/* メイン関数 */
int main(void)
{
	/* 加速度センサの初期化 */
	int ret = accel_init();

	if (ret < 0)
	{
		LOG_ERR("MPU6886 is not ready: %d", ret);
		return ret;
	}
	k_timer_start(&sample_timer, K_NO_WAIT, K_MSEC(ACCEL_PERIOD_MS));
	while (true)
	{
		char json[ACCEL_JSON_SIZE];

		(void)k_timer_status_sync(&sample_timer);

		/* 加速度データをJSON形式で取得 */
		ret = accel_read_json(json, sizeof(json));
		if (ret < 0)
		{
			LOG_ERR("Read/encode failed: %d", ret);
			continue;
		}
		printk("%s\n", json);
	}
	return 0;
}
```
