## CMakeLists.txt
```
# SPDX-License-Identifier: Apache-2.0
cmake_minimum_required(VERSION 3.20.0)
find_package(Zephyr REQUIRED HINTS
  "${CMAKE_CURRENT_SOURCE_DIR}/../../zephyr/share/zephyr-package/cmake")
project(zenoh_accel)

set(COMMON_DIR ${CMAKE_CURRENT_SOURCE_DIR}/../common)
target_include_directories(app PRIVATE ${COMMON_DIR})
target_sources(app PRIVATE
  src/main.c
  ${COMMON_DIR}/accel.c
  ${COMMON_DIR}/network.c
)
```

## prj.conf
```kconfig
# SPDX-License-Identifier: Apache-2.0
# 加速度センサに関する設定
CONFIG_SENSOR=y
CONFIG_MPU6050=y
CONFIG_I2C=y

# スレッドのスタックサイズ
CONFIG_MAIN_STACK_SIZE=6144
CONFIG_SYSTEM_WORKQUEUE_STACK_SIZE=2048
CONFIG_NET_RX_STACK_SIZE=2048
CONFIG_NET_TX_STACK_SIZE=2048
CONFIG_INIT_STACKS=y

# 64ビット整数を含む整数の書式変換を有効にする
CONFIG_CBPRINTF_FULL_INTEGRAL=y

# ロギングに関する設定
CONFIG_LOG=y
CONFIG_LOG_PRINTK=y
CONFIG_LOG_MODE_DEFERRED=y
CONFIG_LOG_PROCESS_TRIGGER_THRESHOLD=1
CONFIG_LOG_BUFFER_SIZE=4096
CONFIG_NET_LOG=y
CONFIG_WIFI_LOG_LEVEL_INF=y

# Wi-FiとIPv4に関する設定
CONFIG_NETWORKING=y
CONFIG_WIFI=y
CONFIG_NET_IPV4=y
CONFIG_NET_IPV6=n
CONFIG_NET_DHCPV4=y
CONFIG_ESP32_WIFI_STA_AUTO_DHCPV4=y

# ソケット通信に関する設定
CONFIG_NET_TCP=y
CONFIG_NET_UDP=y
CONFIG_NET_SOCKETS=y
# ソケットの送信タイムアウトを有効にする
CONFIG_NET_CONTEXT_SNDTIMEO=y

# ネットワークのイベントキューと送受信バッファ
CONFIG_NET_MGMT_EVENT_QUEUE_SIZE=16
CONFIG_NET_MGMT_EVENT_QUEUE_TIMEOUT=5000
CONFIG_NET_PKT_RX_COUNT=16
CONFIG_NET_PKT_TX_COUNT=16
CONFIG_NET_BUF_RX_COUNT=64
CONFIG_NET_BUF_TX_COUNT=64
CONFIG_NET_MAX_CONTEXTS=12
CONFIG_NET_MAX_CONN=12

# zenoh-picoが使用するヒープとPOSIX API
CONFIG_HEAP_MEM_POOL_SIZE=65536
CONFIG_POSIX_API=y
CONFIG_MAX_PTHREAD_MUTEX_COUNT=16
CONFIG_MAX_PTHREAD_COND_COUNT=8
CONFIG_NET_CONTEXT_RCVTIMEO=y

# zenoh-picoの出版機能とTCP接続
CONFIG_ZENOH_PICO=y
CONFIG_ZENOH_PICO_PUBLICATION=y
CONFIG_ZENOH_PICO_MULTI_THREAD=y
CONFIG_ZENOH_PICO_LINK_TCP=y
CONFIG_ZENOH_PICO_UNICAST_TRANSPORT=y
# 購読者の関心通知，分割転送，エンコーディング定義などを有効にする
CONFIG_ZENOH_PICO_INTEREST=y
CONFIG_ZENOH_PICO_FRAGMENTATION=y
CONFIG_ZENOH_PICO_ENCODING_VALUES=y
CONFIG_ZENOH_PICO_TCP_NODELAY=y
CONFIG_ZENOH_PICO_SESSION_CHECK=y
CONFIG_ZENOH_PICO_SCOUTING=n
CONFIG_ZENOH_PICO_LINK_UDP_UNICAST=n
CONFIG_ZENOH_PICO_LINK_UDP_MULTICAST=n
```

## src/main.c
```c
/* SPDX-License-Identifier: Apache-2.0 */
#include <zephyr/kernel.h>
#include <zephyr/logging/log.h>
#include <zenoh-pico.h>

#include "accel.h"
#include "network.h"

/* Zenohの設定としてホストPCのIPアドレスとポートを指定する */
#define ROUTER_ENDPOINT "tcp/192.168.11.100:7447"
/* Zenoh通信のKey名を指定する */
#define ACCEL_KEY "cqif/device01/accel"

#define ACCEL_PERIOD_MS 100

LOG_MODULE_REGISTER(zenoh_accel, LOG_LEVEL_INF);

int main(void)
{
	int ret = accel_init();

	if (ret < 0)
	{
		LOG_ERR("Sensor initialization failed: %d", ret);
		return ret;
	}
	ret = network_connect();
	if (ret < 0)
	{
		LOG_ERR("Wi-Fi connection failed: %d", ret);
		return ret;
	}

	/* clientモードでPC上のルータへ接続する */
	z_owned_config_t config;

	ret = z_config_default(&config);
	if (ret < 0)
	{
		LOG_ERR("Config creation failed: %d", ret);
		return ret;
	}
	ret = zp_config_insert(z_loan_mut(config), Z_CONFIG_MODE_KEY, "client");
	if (ret == 0)
	{
		ret = zp_config_insert(z_loan_mut(config), Z_CONFIG_CONNECT_KEY, ROUTER_ENDPOINT);
	}
	if (ret < 0)
	{
		LOG_ERR("Config setup failed: %d", ret);
		z_drop(z_move(config));
		return ret;
	}

	/* Zenohのセッションを開く */
	z_owned_session_t session;
	ret = z_open(&session, z_move(config), NULL);
	if (ret < 0)
	{
		LOG_ERR("Session open failed: %d", ret);
		return ret;
	}
	LOG_INF("Session opened: %s", ROUTER_ENDPOINT);

	/* 加速度データを出版するキーを宣言する */
	z_view_keyexpr_t key;
	z_owned_publisher_t publisher;
	ret = z_view_keyexpr_from_str(&key, ACCEL_KEY);
	if (ret < 0)
	{
		goto close_session;
	}
	ret = z_declare_publisher(z_loan(session), &publisher, z_loan(key), NULL);
	if (ret < 0)
	{
		goto close_session;
	}
	LOG_INF("Publishing: %s", ACCEL_KEY);

	while (true)
	{
		char json[ACCEL_JSON_SIZE];

		/* 加速度データをJSON形式で取得する */
		ret = accel_read_json(json, sizeof(json));
		if (ret < 0)
		{
			break;
		}

		/* 1サンプルを1つのペイロードにコピーする */
		z_owned_bytes_t payload;
		ret = z_bytes_copy_from_str(&payload, json);
		if (ret < 0)
		{
			break;
		}

		/* ペイロードの所有権を渡して出版する */
		ret = z_publisher_put(z_loan(publisher), z_move(payload), NULL);
		if (ret < 0)
		{
			break;
		}
		k_msleep(ACCEL_PERIOD_MS);
	}
	z_drop(z_move(publisher));

close_session:
	LOG_ERR("Publication stopped: %d", ret);
	z_drop(z_move(session));
	return ret;
}
```
